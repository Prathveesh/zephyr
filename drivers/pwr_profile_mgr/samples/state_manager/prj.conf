## CMakeLists.txt
```
cmake_minimum_required(VERSION 3.20.0)
find_package(Zephyr REQUIRED HINTS $ENV{ZEPHYR_BASE})
project(state_manager)

target_sources(app PRIVATE src/main.c)
```

## prj.conf
```kconfig
# SPDX-License-Identifier: Apache-2.0

CONFIG_PWR_PROFILE_MGR=y
CONFIG_PWR_PROFILE_MGR_LOG_LEVEL_INF=y
CONFIG_PM=y
CONFIG_GPIO=y
CONFIG_PRINTK=y
CONFIG_LOG=y
CONFIG_LOG_PRINTK=y

# Live log over the existing SWD/ST-LINK connection (OpenOCD's rtt
# server) -- this board's ST-LINK VCP is not wired to a UART, so this
# is the debug-console path instead of a real UART.
CONFIG_USE_SEGGER_RTT=y
CONFIG_LOG_BACKEND_RTT=y
CONFIG_LOG_BACKEND_RTT_MODE_BLOCK=y
```

## src/main.c
```c
/*
 * SPDX-License-Identifier: Apache-2.0
 */

/*
 * v1: button-triggered suspend/resume only (REQ-2, REQ-4). CLI trigger
 * (REQ-3, REQ-5) is deferred to a later release (Requirements/
 * REQUIREMENTS.md REQ-20), so this sample has no shell commands yet --
 * the pwr_profile_mgr_stm32f4 backend's button ISR/k_work wiring
 * (REQ-15) drives the whole demo on its own once initialized.
 */

#include <zephyr/kernel.h>
#include <zephyr/sys/printk.h>

int main(void)
{
	printk("state_manager: ready. Press the user button to suspend/resume.\n");

	return 0;
}
```
